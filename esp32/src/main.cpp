// Hoermann SupraMatic (BlueSecur BLE) <-> MQTT bridge for Home Assistant.
// Seeed XIAO ESP32-C3.
//
// Protocol reverse-engineered from the official BlueSecur Android app
// (Hoermann.BleApp.Core / SAL.BlueConnect.IO.{Signed,Encrypted}):
//   - One-time key registration: random 32-byte key, RSA(PKCS#1 v1.5)-
//     encrypted with the gate's own public key (printed as a QR code on the
//     drive), delivered over BLE. Only accepted while the gate is in its
//     own "BLE pairing" window (menu 19 -> BLE on the drive's own panel).
//   - Every command after that: HMAC-SHA256(key, header+payload+challenge),
//     where "challenge" is an 8-byte rolling token the gate hands out on
//     every notification.
// See C:\Users\serge\HoermannBLE\ for the PC-side research/PoC this was
// ported from.

#include <Arduino.h>
#include <WiFi.h>
#include <ESPmDNS.h>
#include <PubSubClient.h>
#include <Preferences.h>
#include <NimBLEDevice.h>
#include <mbedtls/pk.h>
#include <mbedtls/md.h>
#include <mbedtls/entropy.h>
#include <mbedtls/ctr_drbg.h>

#include "secrets_generated.h"  // generated by gen_secrets.py from the local-only secret files

// ---------------------------------------------------------------------------
// Gate identity (found by BLE sniffing in the PC-side research phase)
// ---------------------------------------------------------------------------
static const char *GATE_ADDR = "e5:9b:6b:d2:84:d9";
static const int GATE_ADDR_TYPE = BLE_ADDR_RANDOM;
static const char *SERVICE_UUID = "669a9001-0008-968f-e311-6050405558b3";
static const char *NOTIFY_UUID = "669a900a-0008-968f-e311-6050405558b3";
static const char *WRITE_UUID = "669a900c-0008-968f-e311-6050405558b3";

// BlueConnect "Signed" command IDs (low 16 bits of DeviceAction, from the
// decompiled DeviceAction enum). All identified by pressing each Home
// Assistant button once and watching the gate: CHANNEL_1=Impuls, CHANNEL_2=
// Light (19/19 isolated captures), CHANNEL_3=Open Partial (1/2), CHANNEL_4=
// Open, CHANNEL_5=Close, CHANNEL_6=Ventilation Position.
enum GateCommand : uint16_t {
  CMD_REGISTER_ROOT = 0x0001,
  CMD_CHANNEL_1 = 0x0011,
  CMD_CHANNEL_2_LIGHT = 0x0012,
  CMD_CHANNEL_3 = 0x0013,
  CMD_CHANNEL_4 = 0x0014,
  CMD_CHANNEL_5 = 0x0015,
  CMD_CHANNEL_6 = 0x0016,
};

// SignedNotificationType values actually used here (from the decompiled
// SAL.BlueConnect.IO.Signed.SignedNotificationType enum).
static const uint16_t NOTIF_TYPE_GATE_STATE = 1;
static const uint16_t NOTIF_TYPE_ROOT_KEY = 2;
static const uint16_t NOTIF_TYPE_ENABLED = 4;
static const uint16_t NOTIF_TYPE_SECURITY_ERROR = 65284;  // 0xFF04

// ---------------------------------------------------------------------------
// Globals
// ---------------------------------------------------------------------------
WiFiClient wifiClient;
PubSubClient mqtt(wifiClient);
Preferences prefs;

uint8_t gRootKey[32];
uint16_t gRootId = 0;
bool gHaveKey = false;

std::vector<uint8_t> gNotifyBuf;  // reassembled BLE notification bytes for the current connection

mbedtls_entropy_context gEntropy;
mbedtls_ctr_drbg_context gCtrDrbg;

// ---------------------------------------------------------------------------
// Crypto helpers
// ---------------------------------------------------------------------------
void cryptoInit() {
  mbedtls_entropy_init(&gEntropy);
  mbedtls_ctr_drbg_init(&gCtrDrbg);
  const char *pers = "hoermann_bridge";
  mbedtls_ctr_drbg_seed(&gCtrDrbg, mbedtls_entropy_func, &gEntropy,
                         (const unsigned char *)pers, strlen(pers));
}

// RSA-PKCS#1v1.5 encrypt `data` with the gate's public key (DER SubjectPublicKeyInfo).
bool rsaEncryptWithGatePubkey(const uint8_t *data, size_t dataLen, uint8_t *out, size_t *outLen) {
  mbedtls_pk_context pk;
  mbedtls_pk_init(&pk);
  int rc = mbedtls_pk_parse_public_key(&pk, GATE_PUBKEY_DER, GATE_PUBKEY_DER_LEN);
  if (rc != 0) {
    Serial.printf("mbedtls_pk_parse_public_key failed: -0x%04x\n", -rc);
    mbedtls_pk_free(&pk);
    return false;
  }
  mbedtls_rsa_context *rsa = mbedtls_pk_rsa(pk);
  mbedtls_rsa_set_padding(rsa, MBEDTLS_RSA_PKCS_V15, MBEDTLS_MD_NONE);

  rc = mbedtls_rsa_pkcs1_encrypt(rsa, mbedtls_ctr_drbg_random, &gCtrDrbg,
                                  dataLen, data, out);
  if (rc != 0) {
    Serial.printf("mbedtls_rsa_pkcs1_encrypt failed: -0x%04x\n", -rc);
    mbedtls_pk_free(&pk);
    return false;
  }
  *outLen = mbedtls_rsa_get_len(rsa);  // 256 for the gate's 2048-bit key, confirmed against the real device
  mbedtls_pk_free(&pk);
  return true;
}

void hmacSha256(const uint8_t *key, size_t keyLen,
                const uint8_t *msg1, size_t len1,
                const uint8_t *msg2, size_t len2,
                uint8_t out[32]) {
  mbedtls_md_context_t ctx;
  mbedtls_md_init(&ctx);
  mbedtls_md_setup(&ctx, mbedtls_md_info_from_type(MBEDTLS_MD_SHA256), 1);
  mbedtls_md_hmac_starts(&ctx, key, keyLen);
  mbedtls_md_hmac_update(&ctx, msg1, len1);
  if (msg2 && len2) mbedtls_md_hmac_update(&ctx, msg2, len2);
  mbedtls_md_hmac_finish(&ctx, out);
  mbedtls_md_free(&ctx);
}

// Builds one full "Signed" frame: [1][len16][RootId16][Command16][InnerLen16][payload][hmac32]
// matching SignedCommandBase.Serialize() / SignedWriter in the decompiled app.
std::vector<uint8_t> buildSignedFrame(uint16_t rootId, uint16_t command,
                                       const uint8_t *payload, size_t payloadLen,
                                       const uint8_t *key /* 32 bytes */,
                                       const uint8_t *challenge /* 8 bytes */) {
  uint16_t innerLen = 6 + payloadLen + 32;
  std::vector<uint8_t> message;
  message.reserve(6 + payloadLen);
  message.push_back(rootId & 0xFF);
  message.push_back(rootId >> 8);
  message.push_back(command & 0xFF);
  message.push_back(command >> 8);
  message.push_back(innerLen & 0xFF);
  message.push_back(innerLen >> 8);
  message.insert(message.end(), payload, payload + payloadLen);

  uint8_t sig[32];
  hmacSha256(key, 32, message.data(), message.size(), challenge, 8, sig);

  std::vector<uint8_t> inner = message;
  inner.insert(inner.end(), sig, sig + 32);

  uint16_t outerLen = inner.size() + 3;
  std::vector<uint8_t> outer;
  outer.reserve(outerLen);
  outer.push_back(1);
  outer.push_back(outerLen & 0xFF);
  outer.push_back(outerLen >> 8);
  outer.insert(outer.end(), inner.begin(), inner.end());
  return outer;
}

std::vector<uint8_t> buildRegisterRootCmd(uint16_t rootId, const uint8_t *key, const uint8_t *challenge,
                                           const char *username = "ArnoNym") {
  uint8_t payload[17] = {0};  // [0x00][16-byte username, NUL-padded]
  size_t n = strlen(username);
  if (n > 16) n = 16;
  memcpy(payload + 1, username, n);
  return buildSignedFrame(rootId, CMD_REGISTER_ROOT, payload, sizeof(payload), key, challenge);
}

std::vector<uint8_t> buildSwitchRelaisCmd(uint16_t rootId, uint16_t channelCmd,
                                           const uint8_t *key, const uint8_t *challenge) {
  uint64_t ts = (uint64_t)time(nullptr);  // ROOT_KEY path: just an 8-byte UTC-seconds clock value
  uint8_t payload[8];
  memcpy(payload, &ts, 8);  // little-endian on this MCU, matches the frame's own LE fields
  return buildSignedFrame(rootId, channelCmd, payload, sizeof(payload), key, challenge);
}

// ---------------------------------------------------------------------------
// BLE
// ---------------------------------------------------------------------------
void onGateNotify(NimBLERemoteCharacteristic *, uint8_t *data, size_t len, bool) {
  gNotifyBuf.insert(gNotifyBuf.end(), data, data + len);
}

// Signed-channel notification layout (SignedReader.ReadPackage):
//   outer: [1][len_lo][len_hi]
//   inner: [8-byte challenge][2-byte SignedNotificationType][2-byte ...]
// EVERY type=1 (outer) notification carries a fresh challenge, but which ONE
// is valid to sign with depends on context - e.g. the plain ENABLED (4)
// notification sent right on connect is NOT interchangeable with others.
// wantInnerType<0 accepts any inner type (used for ordinary signed-command
// challenges); EncryptedIO's type=2 progress frames never match here.
bool extractChallenge(uint8_t out[8], int wantInnerType = -1) {
  if (gNotifyBuf.size() < 13 || gNotifyBuf[0] != 1) return false;
  uint16_t innerType = gNotifyBuf[11] | (gNotifyBuf[12] << 8);
  if (wantInnerType >= 0 && innerType != (uint16_t)wantInnerType) return false;
  memcpy(out, gNotifyBuf.data() + 3, 8);
  return true;
}

bool bleWriteChunks(NimBLERemoteCharacteristic *writeChar, const std::vector<uint8_t> &blob,
                     bool withResponse = true) {
  for (size_t i = 0; i < blob.size(); i += 20) {
    size_t n = std::min((size_t)20, blob.size() - i);
    if (!writeChar->writeValue(blob.data() + i, n, withResponse)) {
      Serial.println("  BLE write chunk failed");
      return false;
    }
  }
  return true;
}

// Connects, waits for a fresh challenge. Returns null on failure.
NimBLEClient *bleConnectAndGetChallenge(NimBLERemoteCharacteristic **outNotify,
                                         NimBLERemoteCharacteristic **outWrite,
                                         uint8_t challengeOut[8]) {
  NimBLEClient *client = NimBLEDevice::createClient();
  NimBLEAddress addr(GATE_ADDR, GATE_ADDR_TYPE);
  if (!client->connect(addr)) {
    Serial.println("BLE connect failed");
    NimBLEDevice::deleteClient(client);
    return nullptr;
  }
  NimBLERemoteService *svc = client->getService(SERVICE_UUID);
  if (!svc) {
    Serial.println("Service not found");
    client->disconnect();
    NimBLEDevice::deleteClient(client);
    return nullptr;
  }
  NimBLERemoteCharacteristic *notifyChar = svc->getCharacteristic(NOTIFY_UUID);
  NimBLERemoteCharacteristic *writeChar = svc->getCharacteristic(WRITE_UUID);
  if (!notifyChar || !writeChar) {
    Serial.println("Characteristic not found");
    client->disconnect();
    NimBLEDevice::deleteClient(client);
    return nullptr;
  }
  gNotifyBuf.clear();
  notifyChar->subscribe(true, onGateNotify);

  bool ok = false;
  for (int i = 0; i < 10 && !ok; i++) {
    delay(200);
    ok = extractChallenge(challengeOut);
  }
  if (!ok) {
    Serial.println("No challenge received");
    client->disconnect();
    NimBLEDevice::deleteClient(client);
    return nullptr;
  }
  *outNotify = notifyChar;
  *outWrite = writeChar;
  return client;
}

// One-time: register our own root key. The gate must be in its BLE pairing
// window (its own panel: menu 19 -> 02 BLE -> P, then the Bluetooth button).
//
// Mirrors the PC-side PoC exactly (reverse engineered by sniffing a real
// phone registration, then matched against the decompiled app):
//  1. RSA-deliver a random 32-byte key via EncryptedIO (no challenge needed).
//  2. Wait for the EncryptedIO progress frame to reach step=2 ("02 04 00 02
//     ...") - step going 01 -> 03 (never 02) means this connection attempt
//     is dead; the real app abandons it too and just retries on a FRESH
//     connection (no power-cycle needed).
//  3. The INSTANT step=2 is seen, send RegisterRootCmd signed with the
//     connection's ORIGINAL (ENABLED-type) challenge - not a later one.
//  4. A real success is a 3-chunk ROOT_KEY notification (~60 bytes). Its
//     payload is [2-byte assigned RootId][32-byte key XORed against ours] -
//     un-XOR it to get the actual operational key.
bool registerNewRootKey() {
  Serial.println("Registering a new root key (gate must be in BLE pairing mode)...");

  uint8_t newKey[32];
  for (int i = 0; i < 32; i++) newKey[i] = (uint8_t)esp_random();

  uint8_t encKey[256];
  size_t encLen = 0;
  if (!rsaEncryptWithGatePubkey(newKey, 32, encKey, &encLen)) return false;

  std::vector<uint8_t> regBlob;
  uint16_t regLen = encLen + 3;
  regBlob.push_back(2);
  regBlob.push_back(regLen & 0xFF);
  regBlob.push_back(regLen >> 8);
  regBlob.insert(regBlob.end(), encKey, encKey + encLen);

  bool ok = false;
  for (int outerAttempt = 0; outerAttempt < 5 && !ok; outerAttempt++) {
    Serial.printf("--- registration connection attempt %d ---\n", outerAttempt + 1);

    NimBLEClient *client = NimBLEDevice::createClient();
    NimBLEAddress addr(GATE_ADDR, GATE_ADDR_TYPE);
    if (!client->connect(addr)) {
      Serial.println("  BLE connect failed");
      NimBLEDevice::deleteClient(client);
      delay(500);
      continue;
    }
    NimBLERemoteService *svc = client->getService(SERVICE_UUID);
    NimBLERemoteCharacteristic *notifyChar = svc ? svc->getCharacteristic(NOTIFY_UUID) : nullptr;
    NimBLERemoteCharacteristic *writeChar = svc ? svc->getCharacteristic(WRITE_UUID) : nullptr;
    if (!notifyChar || !writeChar) {
      Serial.println("  service/characteristic not found");
      client->disconnect();
      NimBLEDevice::deleteClient(client);
      delay(500);
      continue;
    }
    gNotifyBuf.clear();
    notifyChar->subscribe(true, onGateNotify);

    uint8_t initialChallenge[8];
    bool haveInitial = false;
    for (int i = 0; i < 10 && !haveInitial; i++) {
      delay(100);
      haveInitial = extractChallenge(initialChallenge, NOTIF_TYPE_ENABLED);
    }
    if (!haveInitial) {
      Serial.println("  no initial challenge, retrying...");
      client->disconnect();
      NimBLEDevice::deleteClient(client);
      delay(500);
      continue;
    }

    Serial.println("  sending RSA registration blob...");
    gNotifyBuf.clear();
    bleWriteChunks(writeChar, regBlob);

    Serial.println("  waiting for EncryptedIO progress step=2 (up to ~22s)...");
    bool gotStep2 = false;
    size_t scanned = 0;
    for (int i = 0; i < 110 && !gotStep2; i++) {  // up to ~22s
      delay(200);
      // Each progress notification is its own 20-byte chunk: [2][04][00][step][...].
      // gNotifyBuf just accumulates raw bytes in order, so walk it 20 bytes at a time.
      for (; scanned + 4 <= gNotifyBuf.size(); scanned += 20) {
        if (gNotifyBuf[scanned] == 2 && gNotifyBuf[scanned + 3] == 2) {
          gotStep2 = true;
          break;
        }
      }
    }
    if (!gotStep2) {
      Serial.println("  step=2 never arrived this connection, abandoning (no power-cycle needed)");
      client->disconnect();
      NimBLEDevice::deleteClient(client);
      delay(500);
      continue;
    }
    Serial.println("  got step=2, sending RegisterRoot immediately with the initial challenge...");

    gNotifyBuf.clear();
    auto frame = buildRegisterRootCmd(0, newKey, initialChallenge);  // RootId=0 for this bootstrap frame only
    // Write-without-response here: the device seems to disconnect very soon
    // after step=2, and NimBLE's per-chunk ack round-trip (write-with-response)
    // was sometimes too slow to get all 3 chunks out in time ("BLE write
    // chunk failed" after the link dropped mid-send).
    bleWriteChunks(writeChar, frame, false);

    bool isError = false;
    for (int i = 0; i < 30; i++) {  // up to 3s
      delay(100);
      if (gNotifyBuf.size() >= 13 && gNotifyBuf[11] == 4 && gNotifyBuf[12] == 0xFF) {
        isError = true;
        break;
      }
      if (gNotifyBuf.size() >= 55) break;
    }
    Serial.printf("  RegisterRoot response: %u bytes (%s)\n", (unsigned)gNotifyBuf.size(),
                  isError ? "SECURITY_ERROR" : "...");

    if (gNotifyBuf.size() >= 55 && !isError) {
      // ROOT_KEY notification inner payload (after the 8-byte challenge +
      // 2-byte type + 2-byte discarded field already skipped by our offset):
      // [2-byte RootId][32-byte key XORed against newKey].
      uint16_t assignedRootId = gNotifyBuf[15] | (gNotifyBuf[16] << 8);
      uint8_t finalKey[32];
      for (int i = 0; i < 32; i++) finalKey[i] = gNotifyBuf[17 + i] ^ newKey[i];

      memcpy(gRootKey, finalKey, 32);
      gRootId = assignedRootId;
      prefs.begin("hoermann", false);
      prefs.putBytes("rootkey", gRootKey, 32);
      prefs.putUShort("rootid", gRootId);
      prefs.end();
      gHaveKey = true;
      Serial.printf("New root key registered and saved to flash (RootId=%u).\n", gRootId);
      ok = true;
    }

    client->disconnect();
    NimBLEDevice::deleteClient(client);
    if (!ok) delay(500);
  }

  if (!ok) {
    Serial.println("Registration failed after several fresh-connection retries. "
                    "If this keeps happening, power-cycle the gate and re-open BLE pairing mode.");
  }
  return ok;
}

bool sendGateCommand(uint16_t channelCmd) {
  if (!gHaveKey) {
    Serial.println("No root key yet - publish to .../cmd/register first.");
    return false;
  }
  NimBLERemoteCharacteristic *notifyChar, *writeChar;
  uint8_t challenge[8];
  NimBLEClient *client = bleConnectAndGetChallenge(&notifyChar, &writeChar, challenge);
  if (!client) return false;

  gNotifyBuf.clear();
  auto frame = buildSwitchRelaisCmd(gRootId, channelCmd, gRootKey, challenge);
  bool ok = bleWriteChunks(writeChar, frame);
  delay(500);  // let any ack notification arrive before we tear the link down

  client->disconnect();
  NimBLEDevice::deleteClient(client);
  return ok;
}

// ---------------------------------------------------------------------------
// MQTT / Home Assistant
// ---------------------------------------------------------------------------
static const char *DEVICE_ID = "hoermann_gate";
static const char *CMD_TOPIC_PREFIX = "hoermann/gate/cmd/";
static const char *AVAIL_TOPIC = "hoermann/gate/status";

struct ChannelDef {
  const char *slug;
  const char *name;
  uint16_t cmd;
};
static const ChannelDef CHANNELS[] = {
    {"impuls", "Impuls", CMD_CHANNEL_1},
    {"light", "Light", CMD_CHANNEL_2_LIGHT},
    {"partial", "Open Partial (1/2)", CMD_CHANNEL_3},
    {"open", "Open", CMD_CHANNEL_4},
    {"close", "Close", CMD_CHANNEL_5},
    {"ventilation", "Ventilation Position", CMD_CHANNEL_6},
};
static const size_t CHANNEL_COUNT = sizeof(CHANNELS) / sizeof(CHANNELS[0]);

void publishHADiscovery() {
  for (size_t i = 0; i < CHANNEL_COUNT; i++) {
    char topic[160], payload[400], cmdTopic[96], uid[64];
    snprintf(cmdTopic, sizeof(cmdTopic), "%s%s", CMD_TOPIC_PREFIX, CHANNELS[i].slug);
    snprintf(uid, sizeof(uid), "%s_%s", DEVICE_ID, CHANNELS[i].slug);
    snprintf(topic, sizeof(topic), "homeassistant/button/%s/config", uid);
    snprintf(payload, sizeof(payload),
             "{\"name\":\"%s\",\"uniq_id\":\"%s\",\"cmd_t\":\"%s\",\"avty_t\":\"%s\","
             "\"dev\":{\"ids\":[\"%s\"],\"name\":\"Hoermann Gate\",\"mf\":\"DIY\"}}",
             CHANNELS[i].name, uid, cmdTopic, AVAIL_TOPIC, DEVICE_ID);
    mqtt.publish(topic, payload, true);
  }
  // one extra button to (re-)register a key while the gate is in pairing mode
  char uid[64], cmdTopic[96], topic[160], payload[400];
  snprintf(uid, sizeof(uid), "%s_register", DEVICE_ID);
  snprintf(cmdTopic, sizeof(cmdTopic), "%sregister", CMD_TOPIC_PREFIX);
  snprintf(topic, sizeof(topic), "homeassistant/button/%s/config", uid);
  snprintf(payload, sizeof(payload),
           "{\"name\":\"Register new key\",\"uniq_id\":\"%s\",\"cmd_t\":\"%s\",\"avty_t\":\"%s\","
           "\"dev\":{\"ids\":[\"%s\"],\"name\":\"Hoermann Gate\",\"mf\":\"DIY\"}}",
           uid, cmdTopic, AVAIL_TOPIC, DEVICE_ID);
  mqtt.publish(topic, payload, true);

  mqtt.publish(AVAIL_TOPIC, "online", true);
}

// PubSubClient callbacks must return quickly - registerNewRootKey() can run
// for 1-2+ minutes (several BLE reconnect attempts, each waiting up to ~22s).
// Running that directly inside the callback starved the main loop() for too
// long and the board rebooted. Defer it: just set a flag here, and run the
// actual registration from loop(), where we can call mqtt.loop()/yield()
// between BLE attempts to keep MQTT and the watchdog happy.
volatile bool gRegisterRequested = false;

void onMqttMessage(char *topic, byte *payload, unsigned int length) {
  String t(topic);
  if (!t.startsWith(CMD_TOPIC_PREFIX)) return;
  String slug = t.substring(strlen(CMD_TOPIC_PREFIX));

  if (slug == "register") {
    gRegisterRequested = true;
    return;
  }
  for (size_t i = 0; i < CHANNEL_COUNT; i++) {
    if (slug == CHANNELS[i].slug) {
      Serial.printf("MQTT command: %s\n", CHANNELS[i].name);
      bool ok = sendGateCommand(CHANNELS[i].cmd);
      Serial.println(ok ? "  sent OK" : "  FAILED");
      return;
    }
  }
}

void mqttReconnect() {
  // Resolve a .local hostname via mDNS each time (no static IP / DHCP
  // reservation needed on the router).
  IPAddress host;
  String hostStr(MQTT_HOST);
  if (hostStr.endsWith(".local")) {
    String shortName = hostStr.substring(0, hostStr.length() - 6);
    host = MDNS.queryHost(shortName);
    if (host == IPAddress(0, 0, 0, 0)) {
      Serial.println("mDNS resolve failed, will retry");
      return;
    }
  } else {
    if (!host.fromString(hostStr)) {
      Serial.println("MQTT_HOST is neither a .local name nor a valid IP");
      return;
    }
  }
  mqtt.setServer(host, MQTT_PORT);

  Serial.printf("Connecting to MQTT %s:%d ...\n", host.toString().c_str(), MQTT_PORT);
  bool connected = (strlen(MQTT_USER) > 0)
                        ? mqtt.connect(DEVICE_ID, MQTT_USER, MQTT_PASSWORD, AVAIL_TOPIC, 0, true, "offline")
                        : mqtt.connect(DEVICE_ID, AVAIL_TOPIC, 0, true, "offline");
  if (connected) {
    Serial.println("MQTT connected");
    char sub[96];
    snprintf(sub, sizeof(sub), "%s#", CMD_TOPIC_PREFIX);
    mqtt.subscribe(sub);
    publishHADiscovery();
  } else {
    Serial.printf("MQTT connect failed, rc=%d\n", mqtt.state());
  }
}

// ---------------------------------------------------------------------------
// Arduino entry points
// ---------------------------------------------------------------------------
void setup() {
  Serial.begin(115200);
  delay(500);
  Serial.println("\nHoermann BLE<->MQTT bridge starting");

  cryptoInit();

  prefs.begin("hoermann", true);
  if (prefs.getBytesLength("rootkey") == 32) {
    prefs.getBytes("rootkey", gRootKey, 32);
    gRootId = prefs.getUShort("rootid", 0);
    gHaveKey = true;
    Serial.printf("Loaded saved root key from flash (RootId=%u).\n", gRootId);
  } else {
    Serial.println("No root key saved yet - use the 'register' MQTT button "
                    "while the gate is in BLE pairing mode.");
  }
  prefs.end();

  NimBLEDevice::init("hoermann-bridge");

  WiFi.mode(WIFI_STA);

  Serial.println("Scanning for WiFi networks...");
  int n = WiFi.scanNetworks();
  bool sawTarget = false;
  for (int i = 0; i < n; i++) {
    String ssid = WiFi.SSID(i);
    Serial.printf("  [%2d] rssi=%4d ch=%2d enc=%d  %s%s\n", i, WiFi.RSSI(i), WiFi.channel(i),
                  (int)WiFi.encryptionType(i), ssid.c_str(),
                  ssid == WIFI_SSID ? "   <-- target" : "");
    if (ssid == WIFI_SSID) sawTarget = true;
  }
  if (!sawTarget) {
    Serial.println("WARNING: target SSID was not seen in the scan at all "
                    "(out of range, 5GHz-only band, or hidden network).");
  }

  WiFi.begin(WIFI_SSID, WIFI_PASSWORD);
  Serial.printf("Connecting to WiFi '%s'", WIFI_SSID);
  uint32_t wifiStart = millis();
  while (WiFi.status() != WL_CONNECTED && millis() - wifiStart < 20000) {
    delay(300);
    Serial.print(".");
  }
  if (WiFi.status() != WL_CONNECTED) {
    Serial.printf("\nWiFi FAILED to connect, status=%d. Will keep retrying in the background.\n",
                  (int)WiFi.status());
  } else {
    Serial.printf("\nWiFi connected, IP=%s\n", WiFi.localIP().toString().c_str());
  }

  MDNS.begin("hoermann-bridge");

  // Keep the system clock roughly right - ROOT_KEY-signed commands embed a
  // UTC timestamp; wait briefly for it rather than sending a 1970 epoch.
  configTime(0, 0, "pool.ntp.org", "time.nist.gov");
  Serial.print("Waiting for NTP time sync");
  time_t now = time(nullptr);
  uint32_t ntpStart = millis();
  while (now < 1700000000 && millis() - ntpStart < 8000) {
    delay(300);
    Serial.print(".");
    now = time(nullptr);
  }
  Serial.println(now >= 1700000000 ? " ok" : " timed out (continuing anyway)");

  mqtt.setCallback(onMqttMessage);
}

void loop() {
  if (WiFi.status() != WL_CONNECTED) {
    delay(1000);
    return;
  }
  if (!mqtt.connected()) {
    static uint32_t lastAttempt = 0;
    if (millis() - lastAttempt > 5000) {
      lastAttempt = millis();
      mqttReconnect();
    }
  } else {
    mqtt.loop();
  }

  if (gRegisterRequested) {
    gRegisterRequested = false;
    registerNewRootKey();
  }
}
